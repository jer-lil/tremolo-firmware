/* USER CODE BEGIN Header */
/**
  ******************************************************************************
  * @file           : main.c
  * @brief          : Main program body
  ******************************************************************************
  * @attention
  *
  * Copyright (c) 2022 STMicroelectronics.
  * All rights reserved.
  *
  * This software is licensed under terms that can be found in the LICENSE file
  * in the root directory of this software component.
  * If no LICENSE file comes with this software, it is provided AS-IS.
  *
  ******************************************************************************
  */
/* USER CODE END Header */
/* Includes ------------------------------------------------------------------*/
#include "main.h"
#include "adc.h"
#include "dma.h"
#include "tim.h"
#include "usart.h"
#include "gpio.h"

/* Private includes ----------------------------------------------------------*/
/* USER CODE BEGIN Includes */

#include "Lib/sm_bypass.h"
#include "Lib/led.h"
#include "Lib/wavetable_gen.h"
#include "Lib/param.h"
#include "Tremolo/tremolo.h"
#include "Tremolo/params.h"

#include <stdint.h>
#include <math.h>
#include <stdbool.h>

/* USER CODE END Includes */

/* Private typedef -----------------------------------------------------------*/
/* USER CODE BEGIN PTD */

typedef struct {
	uint32_t *Rate;
	uint32_t *Depth;
	uint32_t *Phase;
	uint32_t *Offset;
	uint32_t *Sense;
	uint32_t *Exp;
	uint32_t *Env;
	uint32_t *Trim2;
	uint32_t *Vol;
} Adc;

uint32_t timer_freqs[] = {TIM2_FREQ_HZ, TIM3_FREQ_HZ, TIM4_FREQ_HZ, TIM8_FREQ_HZ};

/* USER CODE END PTD */

/* Private define ------------------------------------------------------------*/
/* USER CODE BEGIN PD */
/* USER CODE END PD */

/* Private macro -------------------------------------------------------------*/
/* USER CODE BEGIN PM */

/* USER CODE END PM */

/* Private variables ---------------------------------------------------------*/

/* USER CODE BEGIN PV */


/* USER CODE END PV */

/* Private function prototypes -----------------------------------------------*/
void SystemClock_Config(void);
/* USER CODE BEGIN PFP */

// INIT FUNCTIONS
void init_adc_channels(Adc*, uint32_t[]);
void init_LEDs(LED*, LED*);
void start_dma();
void start_pwm_oc();

// DEBUG
uint32_t num_transmissions = 0;

// CALLBACKS
void My_DMA_XferCpltCallback(DMA_HandleTypeDef*);
void My_DMA_XferHalfCpltCallback(DMA_HandleTypeDef*);
void My_USART_DMA_XferCpltCallback(DMA_HandleTypeDef*);

/* USER CODE END PFP */

/* Private user code ---------------------------------------------------------*/
/* USER CODE BEGIN 0 */

extern StateEffect state_effect;

uint32_t adc_array[ADC_DMA_BUF_LENGTH] = {0};
Adc adc_raw;

uint16_t wavetable_a_lo[WAVETABLE_WIDTH] = {0};
uint16_t wavetable_a_hi[WAVETABLE_WIDTH] = {0};
uint16_t wavetable_b_lo[WAVETABLE_WIDTH] = {0};
uint16_t wavetable_b_hi[WAVETABLE_WIDTH] = {0};

LED LED_bypass;
LED LED_tap;


uint32_t elapsed_sec = 0;


/*
// TODO redo this to match sm_bypass
typedef enum {
	WAITING_FIRST_TAP,
	WAITING_NEXT_TAP,
	DEBOUNCE_PRESSED,
	DEBOUNCE_RELEASED,
	PRESSED,
	HELD,
}TapState;

TapState tap_state = WAITING_NEXT_TAP;
*/

volatile EventSw event_sw_byp = SW_IDLE;
volatile EventSw event_sw_tap = SW_IDLE;

volatile uint32_t latest_tap_us = 0;

/* TODO clean up / move input capture stuff */

/* USER CODE END 0 */

/**
  * @brief  The application entry point.
  * @retval int
  */
int main(void)
{

  /* USER CODE BEGIN 1 */

  /* USER CODE END 1 */

  /* MCU Configuration--------------------------------------------------------*/

  /* Reset of all peripherals, Initializes the Flash interface and the Systick. */
  HAL_Init();

  /* USER CODE BEGIN Init */

  /*
    * Parameters
    */
   // CONTINUOUS
   float rate;
   float depth;
   float offset;
   float phase;
   float vol;
   float sense;

   float env;
   float exp;
   //float ramp_mag;
   //float ramp_rate;

   // DISCRETE
   Shape shape = ERR;
   struct subdiv subdiv = {.num = 1, .denom = 4};

  /* Iniitalize state machines */

  /* USER CODE END Init */

  /* Configure the system clock */
  SystemClock_Config();

  /* USER CODE BEGIN SysInit */
  // Needs to be done first to fix bug in autogenerated code X_X
  MX_DMA_Init();
  /* USER CODE END SysInit */

  /* Initialize all configured peripherals */
  MX_GPIO_Init();
  MX_DMA_Init();
  MX_ADC1_Init();
  MX_TIM2_Init();
  MX_TIM3_Init();
  MX_USART1_UART_Init();
  MX_TIM4_Init();
  MX_TIM8_Init();
  /* USER CODE BEGIN 2 */

  init_LEDs(&LED_bypass, &LED_tap);
  init_adc_channels(&adc_raw, adc_array);
  start_dma();
  start_pwm_oc();

  /* USER CODE END 2 */

  /* Infinite loop */
  /* USER CODE BEGIN WHILE */
  while (1)
  {

	  // Read inputs
	  rate = get_rate(*adc_raw.Rate);
	  depth = get_depth(*adc_raw.Depth);
	  offset = get_offset(*adc_raw.Offset);
	  phase = get_phase_knob(*adc_raw.Phase);
	  env = get_env(*adc_raw.Env);
	  exp = get_exp(*adc_raw.Exp);
	  sense = get_sense(*adc_raw.Sense);
	  vol = get_volume(*adc_raw.Vol);
	  subdiv = get_subdiv();
	  shape = get_shape();
	  // Set things based on parameters
	  set_rate(rate, subdiv);
	  set_volume(vol);
	  HAL_GPIO_WritePin(pDOUT_LED2_R_GPIO_Port, pDOUT_LED2_R_Pin, LED_PIN_RESET);
	  // Generate wavetables
	  wavetable_gen(shape, depth, offset, get_phase(phase, 0), wavetable_a_lo,
			  WAVETABLE_WIDTH, WAVETABLE_DEPTH);
	  wavetable_gen(shape, depth, offset, get_phase(phase, 1), wavetable_a_hi,
				  WAVETABLE_WIDTH, WAVETABLE_DEPTH);
	  wavetable_gen(shape, depth, offset, get_phase(phase, 2), wavetable_b_lo,
				  WAVETABLE_WIDTH, WAVETABLE_DEPTH);
	  wavetable_gen(shape, depth, offset, get_phase(phase, 3), wavetable_b_hi,
				  WAVETABLE_WIDTH, WAVETABLE_DEPTH);

	  HAL_GPIO_WritePin(pDOUT_LED2_R_GPIO_Port, pDOUT_LED2_R_Pin, LED_PIN_SET);

	  // Run bypass switch state machine, and reset event to IDLE
	  // TODO define TIM_IT_CC1 in main.h
	  EventSw current_event_sw_byp = __atomic_exchange_n(&event_sw_byp, SW_IDLE, __ATOMIC_SEQ_CST);
	  EventSwOutput current_event_eff = sm_byp_sw(current_event_sw_byp);
	  sm_effect(current_event_eff);
	  sm_relay_mute(state_effect, &LED_bypass);

	  // Run tap switch state machine
	  // TODO define TIM_IT_CC2 in main.h
	  __HAL_TIM_DISABLE_IT(&HTIM_BTN_IN, TIM_IT_CC2);
	  EventSw current_event_sw_tap = __atomic_exchange_n(&event_sw_tap, SW_IDLE, __ATOMIC_SEQ_CST);
	  uint32_t current_latest_tap_us = latest_tap_us;
	  __HAL_TIM_ENABLE_IT(&HTIM_BTN_IN, TIM_IT_CC2);
	  EventSwOutput sw_sm_output = sm_tap_sw(current_event_sw_tap, current_latest_tap_us);
  }
    /* USER CODE END WHILE */

    /* USER CODE BEGIN 3 */
  /* USER CODE END 3 */
}

/**
  * @brief System Clock Configuration
  * @retval None
  */
void SystemClock_Config(void)
{
  RCC_OscInitTypeDef RCC_OscInitStruct = {0};
  RCC_ClkInitTypeDef RCC_ClkInitStruct = {0};
  RCC_PeriphCLKInitTypeDef PeriphClkInit = {0};

  /** Initializes the RCC Oscillators according to the specified parameters
  * in the RCC_OscInitTypeDef structure.
  */
  RCC_OscInitStruct.OscillatorType = RCC_OSCILLATORTYPE_HSE;
  RCC_OscInitStruct.HSEState = RCC_HSE_ON;
  RCC_OscInitStruct.HSIState = RCC_HSI_ON;
  RCC_OscInitStruct.PLL.PLLState = RCC_PLL_ON;
  RCC_OscInitStruct.PLL.PLLSource = RCC_PLLSOURCE_HSE;
  RCC_OscInitStruct.PLL.PLLMUL = RCC_PLL_MUL4;
  RCC_OscInitStruct.PLL.PREDIV = RCC_PREDIV_DIV1;
  if (HAL_RCC_OscConfig(&RCC_OscInitStruct) != HAL_OK)
  {
    Error_Handler();
  }

  /** Initializes the CPU, AHB and APB buses clocks
  */
  RCC_ClkInitStruct.ClockType = RCC_CLOCKTYPE_HCLK|RCC_CLOCKTYPE_SYSCLK
                              |RCC_CLOCKTYPE_PCLK1|RCC_CLOCKTYPE_PCLK2;
  RCC_ClkInitStruct.SYSCLKSource = RCC_SYSCLKSOURCE_PLLCLK;
  RCC_ClkInitStruct.AHBCLKDivider = RCC_SYSCLK_DIV1;
  RCC_ClkInitStruct.APB1CLKDivider = RCC_HCLK_DIV1;
  RCC_ClkInitStruct.APB2CLKDivider = RCC_HCLK_DIV1;

  if (HAL_RCC_ClockConfig(&RCC_ClkInitStruct, FLASH_LATENCY_1) != HAL_OK)
  {
    Error_Handler();
  }
  PeriphClkInit.PeriphClockSelection = RCC_PERIPHCLK_USART1|RCC_PERIPHCLK_TIM8
                              |RCC_PERIPHCLK_ADC12|RCC_PERIPHCLK_TIM2
                              |RCC_PERIPHCLK_TIM34;
  PeriphClkInit.Usart1ClockSelection = RCC_USART1CLKSOURCE_PCLK2;
  PeriphClkInit.Adc12ClockSelection = RCC_ADC12PLLCLK_DIV8;
  PeriphClkInit.Tim8ClockSelection = RCC_TIM8CLK_PLLCLK;
  PeriphClkInit.Tim2ClockSelection = RCC_TIM2CLK_PLLCLK;
  PeriphClkInit.Tim34ClockSelection = RCC_TIM34CLK_PLLCLK;
  if (HAL_RCCEx_PeriphCLKConfig(&PeriphClkInit) != HAL_OK)
  {
    Error_Handler();
  }
}

/* USER CODE BEGIN 4 */

/*
 * 	INIT/START FUNCTIONS
 */

void start_dma()
{
	// ADC DMA
	if (HAL_ADC_Start_DMA(&hadc1, adc_array, ADC_DMA_BUF_LENGTH) != HAL_OK)
	{
		Error_Handler();
	}

	// Wavetable DMA

	// Link Transfer complete callback to DMA handle:
	HDMA_WVFM_A_LO.XferCpltCallback = My_DMA_XferCpltCallback;
	HDMA_WVFM_A_LO.XferHalfCpltCallback = My_DMA_XferHalfCpltCallback;
	HDMA_WVFM_A_HI.XferCpltCallback = My_DMA_XferCpltCallback;
	HDMA_WVFM_A_HI.XferHalfCpltCallback = My_DMA_XferHalfCpltCallback;
	HDMA_WVFM_B_LO.XferCpltCallback = My_DMA_XferCpltCallback;
	HDMA_WVFM_B_LO.XferHalfCpltCallback = My_DMA_XferHalfCpltCallback;
	HDMA_WVFM_B_HI.XferCpltCallback = My_DMA_XferCpltCallback;
	HDMA_WVFM_B_HI.XferHalfCpltCallback = My_DMA_XferHalfCpltCallback;

	// First just setting all 4 channels synced to same wavetable
	__HAL_TIM_ENABLE_DMA(&HTIM_WVFM_A_LO, TIM_DMA_CC1);
	__HAL_TIM_ENABLE_DMA(&HTIM_WVFM_A_HI, TIM_DMA_CC2);
	__HAL_TIM_ENABLE_DMA(&HTIM_WVFM_B_LO, TIM_DMA_CC3);
	__HAL_TIM_ENABLE_DMA(&HTIM_WVFM_B_HI, TIM_DMA_CC4);
	__HAL_DMA_ENABLE_IT(&HDMA_WVFM_A_LO, DMA_IT_HT);
	__HAL_DMA_ENABLE_IT(&HDMA_WVFM_A_HI, DMA_IT_HT);
	__HAL_DMA_ENABLE_IT(&HDMA_WVFM_B_LO, DMA_IT_HT);
	__HAL_DMA_ENABLE_IT(&HDMA_WVFM_B_HI, DMA_IT_HT);
	HAL_DMA_Start_IT(&HDMA_WVFM_A_LO, (uint32_t)wavetable_a_lo,
			(uint32_t)&DMA_DST_PWM_A_LO, WAVETABLE_WIDTH);
	HAL_DMA_Start_IT(&HDMA_WVFM_A_HI, (uint32_t)wavetable_a_hi,
			(uint32_t)&DMA_DST_PWM_A_HI, WAVETABLE_WIDTH);
	HAL_DMA_Start_IT(&HDMA_WVFM_B_LO, (uint32_t)wavetable_b_lo,
			(uint32_t)&DMA_DST_PWM_B_LO, WAVETABLE_WIDTH);
	HAL_DMA_Start_IT(&HDMA_WVFM_B_HI, (uint32_t)wavetable_b_hi,
			(uint32_t)&DMA_DST_PWM_B_HI, WAVETABLE_WIDTH);

	/*
	  // Enable transfer complete interrupts
	  __HAL_DMA_ENABLE_IT(&hdma_tim8_ch1, DMA_IT_TC);
	  __HAL_DMA_ENABLE_IT(&hdma_tim8_ch2, DMA_IT_TC);
	  __HAL_DMA_ENABLE_IT(&hdma_tim8_ch3_up, DMA_IT_TC);
	  __HAL_DMA_ENABLE_IT(&hdma_tim8_ch4_trig_com, DMA_IT_TC);
	  // Enable transfer half complete interrupts
	  __HAL_DMA_ENABLE_IT(&hdma_tim8_ch1, DMA_IT_HT);
	  __HAL_DMA_ENABLE_IT(&hdma_tim8_ch2, DMA_IT_HT);
	  __HAL_DMA_ENABLE_IT(&hdma_tim8_ch3_up, DMA_IT_HT);
	  __HAL_DMA_ENABLE_IT(&hdma_tim8_ch4_trig_com, DMA_IT_HT);
	*/

	// USART DMA
	HAL_UART_Transmit_DMA(&HUART, (uint8_t*)wavetable_a_lo, WAVETABLE_WIDTH);

	return;
}

void start_pwm_oc()
{
	// Start PWM for Volume outputs
	if ((HAL_TIM_PWM_Start(&HTIM_VOL_A, TIM_CH_VOL_A) |
		  HAL_TIM_PWM_Start(&HTIM_VOL_B, TIM_CH_VOL_B)) != HAL_OK)
	{
		Error_Handler();
	}
	// Start PWM output for PWM timers (the ones that actually output the LFOs)
	if ((HAL_TIM_PWM_Start(&HTIM_PWM_A_LO, TIM_CH_PWM_A_LO) |
			HAL_TIM_PWM_Start(&HTIM_PWM_A_HI, TIM_CH_PWM_A_HI) |
			HAL_TIM_PWM_Start(&HTIM_PWM_B_LO, TIM_CH_PWM_B_LO) |
			HAL_TIM_PWM_Start(&HTIM_PWM_B_HI, TIM_CH_PWM_B_HI)) != HAL_OK)
	{
		Error_Handler();
	}
	// Start output compare for waveform timers (to update the wavetables)
	if ((HAL_TIM_OC_Start(&HTIM_WVFM_A_LO, TIM_CH_WVFM_A_LO) |
		HAL_TIM_OC_Start(&HTIM_WVFM_A_HI, TIM_CH_WVFM_A_HI) |
		HAL_TIM_OC_Start(&HTIM_WVFM_B_LO, TIM_CH_WVFM_B_LO) |
		HAL_TIM_OC_Start(&HTIM_WVFM_B_HI, TIM_CH_WVFM_B_HI)) != HAL_OK)
	{
		Error_Handler();
	}
	if (HAL_TIM_Base_Start_IT(&HTIM_BTN_IN) != HAL_OK)
	{
		Error_Handler();
	}
	if ((HAL_TIM_IC_Start_IT(&HTIM_BTN_IN, TIM_CH_BYP) |
		HAL_TIM_IC_Start_IT(&HTIM_BTN_IN, TIM_CH_TAP) |
		HAL_TIM_IC_Start_IT(&HTIM_BTN_IN, TIM_CH_TAP_EXT))!= HAL_OK)
	{
		Error_Handler();
	}
	return;
}

void init_params()
{
	return;
}

// This maps named Adc struct members to the DMA buffer for convenience
void init_adc_channels(Adc *adc, uint32_t adc_buffer[]){
	adc->Rate = &adc_buffer[0];
	adc->Depth = &adc_buffer[1];
	adc->Phase = &adc_buffer[2];
	adc->Offset = &adc_buffer[3];
	adc->Sense = &adc_buffer[4];
	adc->Exp = &adc_buffer[5];
	adc->Env = &adc_buffer[6];
	adc->Trim2 = &adc_buffer[7];
	adc->Vol = &adc_buffer[8];
}

// Initialize LEDs with GPIO ports/pins, and set default states
void init_LEDs(LED* LED_bypass, LED* LED_tap){
	initLED(LED_tap, GREEN, OFF,
			pDOUT_LED1_R_GPIO_Port, pDOUT_LED1_R_Pin,
			pDOUT_LED1_G_GPIO_Port, pDOUT_LED1_G_Pin,
			pDOUT_LED1_B_GPIO_Port, pDOUT_LED1_B_Pin);
	initLED(LED_bypass, GREEN, OFF,
			pDOUT_LED2_R_GPIO_Port, pDOUT_LED2_R_Pin,
			pDOUT_LED2_G_GPIO_Port, pDOUT_LED2_G_Pin,
			pDOUT_LED2_B_GPIO_Port, pDOUT_LED2_B_Pin);
}

/*
 * CALLBACKS
 */

void HAL_TIM_IC_CaptureCallback(TIM_HandleTypeDef *htim)
{
	if (htim->Channel == HAL_TIM_ACTIVE_CHANNEL_1) {
		// Bypass switch
		// TODO see if there's a better way to detect edge direction than reading the current pin state
		if (!HAL_GPIO_ReadPin(pDIN_BYP_GPIO_Port, pDIN_BYP_Pin)){
			// Falling edge (pressed)
			__atomic_store_n(&event_sw_byp, SW_NEW_PRESS, __ATOMIC_SEQ_CST);
		}
		else {
			// Rising edge (released)
			__atomic_store_n(&event_sw_byp, SW_NEW_RELEASE, __ATOMIC_SEQ_CST);
		}
	}
	if (htim->Channel == HAL_TIM_ACTIVE_CHANNEL_2) {
		// Tap switch
		if (!HAL_GPIO_ReadPin(pDIN_TAP_GPIO_Port, pDIN_TAP_Pin)){
			// Falling edge (pressed)
			latest_tap_us = (1000000 * elapsed_sec) + (HAL_TIM_ReadCapturedValue(htim, TIM_CHANNEL_2) << 4);
			__atomic_store_n(&event_sw_tap, SW_NEW_PRESS, __ATOMIC_SEQ_CST);
		}
		else {
			// Currently released
			__atomic_store_n(&event_sw_tap, SW_NEW_RELEASE, __ATOMIC_SEQ_CST);
		}
	}
	if (htim->Channel == HAL_TIM_ACTIVE_CHANNEL_3) {
		// External tap

	}
	return;
}

void HAL_TIM_PeriodElapsedCallback(TIM_HandleTypeDef *htim)
{
	//HAL_GPIO_TogglePin(pDOUT_LED2_B_GPIO_Port, pDOUT_LED2_B_Pin);
	elapsed_sec++;
}

void HAL_ADC_ConvCpltCallback(ADC_HandleTypeDef* hadc)
{

}

void My_DMA_XferHalfCpltCallback(DMA_HandleTypeDef *hdma)
{
	// TODO don't call function from interrupt
	//set_LED_state(&LED_tap, OFF);
	return;
}

void My_DMA_XferCpltCallback(DMA_HandleTypeDef *hdma)
{
	//set_LED_state(&LED_tap, ON);
	return;
}

void HAL_UART_TxCpltCallback(UART_HandleTypeDef *huart)
{
	// Debug

	num_transmissions++;
	//HAL_GPIO_WritePin(pDOUT_LED2_R_GPIO_Port, pDOUT_LED2_R_Pin, LED_PIN_SET);

	// End debug

	static uint8_t table_index = 0;
	static uint8_t segment = 0;

	HAL_StatusTypeDef hal_status;

	if (segment == 0) {
		// Preamble
		uint8_t preamble[3] = {0xAA, 0xAA, table_index};
		hal_status = HAL_UART_Transmit_DMA(huart, preamble, sizeof(preamble));
		if (hal_status != HAL_OK)
		{
			if (hal_status == HAL_ERROR)
			{
				Error_Handler();
			}
			else
			{
				return;
			}
		}
		segment = 1;
	}
	else if (segment == 1) {
		// Timer/Parameter info
		segment = 2;
		hal_status = HAL_UART_Transmit_DMA(huart, (uint8_t*)timer_freqs, sizeof(timer_freqs));
		if (hal_status != HAL_OK)
		{
			if (hal_status == HAL_ERROR)
			{
				Error_Handler();
			}
			else
			{
				return;
			}
		}
	}
	else if (segment == 2) {

		// Table
		uint8_t* current_table;
		switch (table_index)
		{
			case 0:
				current_table = (uint8_t*)wavetable_a_lo;
				break;
			case 1:
				current_table = (uint8_t*)wavetable_a_hi;
				break;
			case 2:
				current_table = (uint8_t*)wavetable_b_lo;
				break;
			case 3:
				current_table = (uint8_t*)wavetable_b_hi;
				break;
			default:
				break;
		}

		table_index = (table_index+1) % 4;
		segment = 0;

		hal_status = HAL_UART_Transmit_DMA(huart, current_table, WAVETABLE_WIDTH*2);
		if (hal_status != HAL_OK)
		{
			if (hal_status == HAL_ERROR)
			{
				Error_Handler();
			}
			else
			{
				return;
			}
		}

	}
	else {
		Error_Handler();
	}
	//HAL_GPIO_WritePin(pDOUT_LED2_R_GPIO_Port, pDOUT_LED2_R_Pin, LED_PIN_RESET);
	return;
}

/* USER CODE END 4 */

/**
  * @brief  This function is executed in case of error occurrence.
  * @retval None
  */
void Error_Handler(void)
{
  /* USER CODE BEGIN Error_Handler_Debug */
  /* User can add his own implementation to report the HAL error return state */
  __disable_irq();

  HAL_GPIO_WritePin(pDOUT_LED2_B_GPIO_Port, pDOUT_LED2_B_Pin, LED_PIN_SET);
  HAL_GPIO_WritePin(pDOUT_LED2_R_GPIO_Port, pDOUT_LED2_R_Pin, LED_PIN_SET);
  HAL_GPIO_WritePin(pDOUT_LED2_G_GPIO_Port, pDOUT_LED2_G_Pin, LED_PIN_SET);
  HAL_GPIO_WritePin(pDOUT_LED1_B_GPIO_Port, pDOUT_LED1_B_Pin, LED_PIN_SET);
  HAL_GPIO_WritePin(pDOUT_LED1_R_GPIO_Port, pDOUT_LED1_R_Pin, LED_PIN_SET);
  HAL_GPIO_WritePin(pDOUT_LED1_G_GPIO_Port, pDOUT_LED1_G_Pin, LED_PIN_SET);

  while (1)
  {
	  HAL_Delay(250);

	  HAL_GPIO_TogglePin(pDOUT_LED2_B_GPIO_Port, pDOUT_LED2_B_Pin);
	  HAL_GPIO_TogglePin(pDOUT_LED2_R_GPIO_Port, pDOUT_LED2_R_Pin);
	  HAL_GPIO_TogglePin(pDOUT_LED2_G_GPIO_Port, pDOUT_LED2_G_Pin);
	  HAL_GPIO_TogglePin(pDOUT_LED1_B_GPIO_Port, pDOUT_LED1_B_Pin);
	  HAL_GPIO_TogglePin(pDOUT_LED1_R_GPIO_Port, pDOUT_LED1_R_Pin);
	  HAL_GPIO_TogglePin(pDOUT_LED1_G_GPIO_Port, pDOUT_LED1_G_Pin);

  }
  /* USER CODE END Error_Handler_Debug */
}

#ifdef  USE_FULL_ASSERT
/**
  * @brief  Reports the name of the source file and the source line number
  *         where the assert_param error has occurred.
  * @param  file: pointer to the source file name
  * @param  line: assert_param error line source number
  * @retval None
  */
void assert_failed(uint8_t *file, uint32_t line)
{
  /* USER CODE BEGIN 6 */
  /* User can add his own implementation to report the file name and line number,
     ex: printf("Wrong parameters value: file %s on line %d\r\n", file, line) */
  /* USER CODE END 6 */
}
#endif /* USE_FULL_ASSERT */
