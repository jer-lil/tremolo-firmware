/* USER CODE BEGIN Header */
/**
  ******************************************************************************
  * @file           : main.c
  * @brief          : Main program body
  ******************************************************************************
  * @attention
  *
  * Copyright (c) 2022 STMicroelectronics.
  * All rights reserved.
  *
  * This software is licensed under terms that can be found in the LICENSE file
  * in the root directory of this software component.
  * If no LICENSE file comes with this software, it is provided AS-IS.
  *
  ******************************************************************************
  */
/* USER CODE END Header */
/* Includes ------------------------------------------------------------------*/
#include <Lib/led.h>
#include <Lib/param.h>
#include <Lib/sm_bypass.h>
#include <Lib/wavetable_gen.h>
#include <Tremolo/params.h>
#include <Tremolo/debug.h>
#include <Tremolo/tremolo.h>
#include "main.h"
#include "adc.h"
#include "dma.h"
#include "tim.h"
#include "usart.h"
#include "gpio.h"

/* Private includes ----------------------------------------------------------*/
/* USER CODE BEGIN Includes */

#include <math.h>

/* USER CODE END Includes */

/* Private typedef -----------------------------------------------------------*/
/* USER CODE BEGIN PTD */

typedef struct {
	uint32_t *Rate;
	uint32_t *Depth;
	uint32_t *Phase; // Formerly Shape
	uint32_t *Offset;
	uint32_t *Sense; // Formerly Subdiv
	uint32_t *Exp;
	uint32_t *Env; // Formerly Trim1
	uint32_t *Trim2;
	uint32_t *Vol;
} Adc;



/* USER CODE END PTD */

/* Private define ------------------------------------------------------------*/
/* USER CODE BEGIN PD */
/* USER CODE END PD */

/* Private macro -------------------------------------------------------------*/
/* USER CODE BEGIN PM */

/* USER CODE END PM */

/* Private variables ---------------------------------------------------------*/

/* USER CODE BEGIN PV */


/* USER CODE END PV */

/* Private function prototypes -----------------------------------------------*/
void SystemClock_Config(void);
/* USER CODE BEGIN PFP */

// INIT FUNCTIONS
void init_adc_channels(Adc*, uint32_t[]);
void init_LEDs(LED*, LED*);
void start_dma();
void start_pwm_oc();
void start_uart();


// CALLBACKS
void My_DMA_XferCpltCallback(DMA_HandleTypeDef*);
void My_DMA_XferHalfCpltCallback(DMA_HandleTypeDef*);


/* USER CODE END PFP */

/* Private user code ---------------------------------------------------------*/
/* USER CODE BEGIN 0 */

uint32_t adc_array[ADC_DMA_BUF_LENGTH] = {0};
Adc adc_raw;

uint16_t wavetable_a_lo[WAVETABLE_WIDTH] = {0};
uint16_t wavetable_a_hi[WAVETABLE_WIDTH] = {0};
uint16_t wavetable_b_lo[WAVETABLE_WIDTH] = {0};
uint16_t wavetable_b_hi[WAVETABLE_WIDTH] = {0};

uint16_t* wavetables[4] = {
		wavetable_a_lo,
		wavetable_a_hi,
		wavetable_b_lo,
		wavetable_b_hi
};

LED LED_bypass;
LED LED_tap;



/* USER CODE END 0 */

/**
  * @brief  The application entry point.
  * @retval int
  */
int main(void)
{
  /* USER CODE BEGIN 1 */

  /* USER CODE END 1 */

  /* MCU Configuration--------------------------------------------------------*/

  /* Reset of all peripherals, Initializes the Flash interface and the Systick. */
  HAL_Init();

  /* USER CODE BEGIN Init */

  /*
   * Parameters
   */
  // CONTINUOUS
  float rate;
  float depth;
  float offset;
  float phase;
  float vol;
  float sense;

  float env;
  float exp;
  //float ramp_mag;
  //float ramp_rate;

  // DISCRETE
  Shape shape = ERR;
  struct subdiv subdiv = {.num = 1, .denom = 4};

  /* Iniitalize state machines */
  StateBypassSw state_bypass_sw = STATE_IDLE;
  StateEffect state_effect = STATE_BYPASS;
  StateRelayMute state_relay_mute = STATE_BYPASS_UNMUTE;



  /* USER CODE END Init */

  /* Configure the system clock */
  SystemClock_Config();

  /* USER CODE BEGIN SysInit */
  // Needs to be done first to fix bug in autogenerated code X_X
  MX_DMA_Init();
  /* USER CODE END SysInit */

  /* Initialize all configured peripherals */
  MX_GPIO_Init();
  MX_ADC1_Init();
  MX_TIM2_Init();
  MX_TIM3_Init();
  MX_DMA_Init();
  MX_USART1_UART_Init();
  MX_TIM4_Init();
  MX_TIM8_Init();
  /* USER CODE BEGIN 2 */

  init_LEDs(&LED_bypass, &LED_tap);
  init_adc_channels(&adc_raw, adc_array);
  start_dma();
  start_pwm_oc();

  start_uart();

  /*
  // Initialize Parameters
  // TODO use macros for min/max values
  // TODO move to function / clean up. Globals?
  struct Param rate = {
  		  .val = adc_raw.Rate,
  		  .map_func = map_rate_pseudo_log,
  		  .val_min = 0,
  		  .val_max = ADC_RESOLUTION,
  		  .map_min = RATE_ARR_MIN,
  		  .map_max = RATE_ARR_MAX,
		  .invert = 1
  };
  struct Param depth = {
  		  .val = adc_raw.Vol,
  		  .map_func = map_param_lin,
  		  .val_min = 0,
  		  .val_max = ADC_RESOLUTION,
  		  .map_min = 0,
  		  .map_max = 1,
		  .invert = 0
  };
  struct Param offset = {
    		  .val = adc_raw.Offset,
    		  .map_func = map_param_lin,
    		  .val_min = 0,
    		  .val_max = ADC_RESOLUTION,
    		  .map_min = 0,
    		  .map_max = 1,
			  .invert = 0
  };
  struct Param phase = {
    		  .val = adc_raw.Shape,
    		  .map_func = map_param_lin,
    		  .val_min = 0,
    		  .val_max = ADC_RESOLUTION,
    		  .map_min = 0,
    		  .map_max = 1,
			  .invert = 0
  };
  struct Param vol = {
    		  .val = adc_raw.Depth,
    		  .map_func = map_param_lin,
    		  .val_min = 0,
    		  .val_max = ADC_RESOLUTION,
    		  .map_min = VOL_MAP_MIN,
    		  .map_max = VOL_MAP_MAX,
			  .invert = 1
  };
  struct Param sense = {
    		  .val = adc_raw.Subdiv,
    		  .map_func = map_param_lin,
    		  .val_min = 0,
    		  .val_max = ADC_RESOLUTION,
    		  .map_min = 0,
    		  .map_max = 1,
			  .invert = 0
  };
  struct Param env = {
    		  .val = adc_raw.Trim1,
    		  .map_func = map_param_lin,
    		  .val_min = 0,
    		  .val_max = ADC_RESOLUTION,
    		  .map_min = 0,
    		  .map_max = 1,
			  .invert = 0
  };
  */



  /* USER CODE END 2 */

  /* Infinite loop */
  /* USER CODE BEGIN WHILE */
  while (1)
  {
	  //rate = *adc_raw.Rate;
	  //depth = *adc_raw.Depth;
	  //offset = *adc_raw.Offset;
	  //env = *adc_raw.Trim1;
	  //phase = *adc_raw.Shape;


	  // Read inputs
	  // TODO do I want a get function for ADC inputs?
	  rate = get_rate(*adc_raw.Rate);
	  depth = get_depth(*adc_raw.Depth);
	  offset = get_offset(*adc_raw.Offset);
	  phase = get_phase_knob(*adc_raw.Phase);
	  env = get_env(*adc_raw.Env);
	  exp = get_exp(*adc_raw.Exp);
	  sense = get_sense(*adc_raw.Sense);
	  vol = get_volume(*adc_raw.Vol);
	  subdiv = get_subdiv();
	  shape = get_shape();

	  // Set things based on parameters
	  set_rate(rate, subdiv);
	  set_volume(vol);
	  // Generate wavetable
	  // TODO change function to take in multiple wavetables
	  update_lfo_waveform(wavetables, sizeof(wavetables), shape, depth, offset, phase);
	  // Send wavetables over UART. Comment out if not needed.
	  transmit_wavetables(&HUART, wavetables, sizeof(wavetables), WAVETABLE_WIDTH);

	  // Check for bypass switch state and run state machine
	  // TODO make this cleaner
	  EventBypassSw event_bypass_sw = EVENT_RELEASED;
	  if (!HAL_GPIO_ReadPin(pDIN_BYP_GPIO_Port, pDIN_BYP_Pin)){
		  event_bypass_sw = EVENT_PRESSED;
	  }
	  sm_bypass_sw(&state_bypass_sw, event_bypass_sw, &state_effect);

	  EventRelayMute event_relay_mute = EVENT_BYPASS;
	  if (state_effect == STATE_EFFECT){
		  event_relay_mute = EVENT_EFFECT;
	  }

	  sm_relay_mute(&state_relay_mute, event_relay_mute, &LED_bypass);
  }
    /* USER CODE END WHILE */

    /* USER CODE BEGIN 3 */
  /* USER CODE END 3 */
}

/**
  * @brief System Clock Configuration
  * @retval None
  */
void SystemClock_Config(void)
{
  RCC_OscInitTypeDef RCC_OscInitStruct = {0};
  RCC_ClkInitTypeDef RCC_ClkInitStruct = {0};
  RCC_PeriphCLKInitTypeDef PeriphClkInit = {0};

  /** Initializes the RCC Oscillators according to the specified parameters
  * in the RCC_OscInitTypeDef structure.
  */
  RCC_OscInitStruct.OscillatorType = RCC_OSCILLATORTYPE_HSE;
  RCC_OscInitStruct.HSEState = RCC_HSE_ON;
  RCC_OscInitStruct.HSIState = RCC_HSI_ON;
  RCC_OscInitStruct.PLL.PLLState = RCC_PLL_ON;
  RCC_OscInitStruct.PLL.PLLSource = RCC_PLLSOURCE_HSE;
  RCC_OscInitStruct.PLL.PLLMUL = RCC_PLL_MUL4;
  RCC_OscInitStruct.PLL.PREDIV = RCC_PREDIV_DIV1;
  if (HAL_RCC_OscConfig(&RCC_OscInitStruct) != HAL_OK)
  {
    Error_Handler();
  }

  /** Initializes the CPU, AHB and APB buses clocks
  */
  RCC_ClkInitStruct.ClockType = RCC_CLOCKTYPE_HCLK|RCC_CLOCKTYPE_SYSCLK
                              |RCC_CLOCKTYPE_PCLK1|RCC_CLOCKTYPE_PCLK2;
  RCC_ClkInitStruct.SYSCLKSource = RCC_SYSCLKSOURCE_PLLCLK;
  RCC_ClkInitStruct.AHBCLKDivider = RCC_SYSCLK_DIV1;
  RCC_ClkInitStruct.APB1CLKDivider = RCC_HCLK_DIV1;
  RCC_ClkInitStruct.APB2CLKDivider = RCC_HCLK_DIV1;

  if (HAL_RCC_ClockConfig(&RCC_ClkInitStruct, FLASH_LATENCY_1) != HAL_OK)
  {
    Error_Handler();
  }
  PeriphClkInit.PeriphClockSelection = RCC_PERIPHCLK_USART1|RCC_PERIPHCLK_TIM8
                              |RCC_PERIPHCLK_ADC12|RCC_PERIPHCLK_TIM2
                              |RCC_PERIPHCLK_TIM34;
  PeriphClkInit.Usart1ClockSelection = RCC_USART1CLKSOURCE_PCLK2;
  PeriphClkInit.Adc12ClockSelection = RCC_ADC12PLLCLK_DIV8;
  PeriphClkInit.Tim8ClockSelection = RCC_TIM8CLK_PLLCLK;
  PeriphClkInit.Tim2ClockSelection = RCC_TIM2CLK_PLLCLK;
  PeriphClkInit.Tim34ClockSelection = RCC_TIM34CLK_PLLCLK;
  if (HAL_RCCEx_PeriphCLKConfig(&PeriphClkInit) != HAL_OK)
  {
    Error_Handler();
  }
}

/* USER CODE BEGIN 4 */

/*
 * 	INIT/START FUNCTIONS
 */

void start_dma()
{
	if (HAL_ADC_Start_DMA(&hadc1, adc_array, ADC_DMA_BUF_LENGTH) != HAL_OK)
	{
		Error_Handler();
	}

	// Link Transfer complete callback to DMA handle:
	HDMA_WVFM_A_LO.XferCpltCallback = My_DMA_XferCpltCallback;
	HDMA_WVFM_A_LO.XferHalfCpltCallback = My_DMA_XferHalfCpltCallback;
	HDMA_WVFM_A_HI.XferCpltCallback = My_DMA_XferCpltCallback;
	HDMA_WVFM_A_HI.XferHalfCpltCallback = My_DMA_XferHalfCpltCallback;
	HDMA_WVFM_B_LO.XferCpltCallback = My_DMA_XferCpltCallback;
	HDMA_WVFM_B_LO.XferHalfCpltCallback = My_DMA_XferHalfCpltCallback;
	HDMA_WVFM_B_HI.XferCpltCallback = My_DMA_XferCpltCallback;
	HDMA_WVFM_B_HI.XferHalfCpltCallback = My_DMA_XferHalfCpltCallback;

	// First just setting all 4 channels synced to same wavetable
	__HAL_TIM_ENABLE_DMA(&HTIM_WVFM_A_LO, TIM_DMA_CC1);
	__HAL_TIM_ENABLE_DMA(&HTIM_WVFM_A_HI, TIM_DMA_CC2);
	__HAL_TIM_ENABLE_DMA(&HTIM_WVFM_B_LO, TIM_DMA_CC3);
	__HAL_TIM_ENABLE_DMA(&HTIM_WVFM_B_HI, TIM_DMA_CC4);
	__HAL_DMA_ENABLE_IT(&HDMA_WVFM_A_LO, DMA_IT_HT);
	__HAL_DMA_ENABLE_IT(&HDMA_WVFM_A_HI, DMA_IT_HT);
	__HAL_DMA_ENABLE_IT(&HDMA_WVFM_B_LO, DMA_IT_HT);
	__HAL_DMA_ENABLE_IT(&HDMA_WVFM_B_HI, DMA_IT_HT);
	HAL_DMA_Start_IT(&HDMA_WVFM_A_LO, (uint32_t)wavetable_a_lo,
			(uint32_t)&DMA_DST_PWM_A_LO, WAVETABLE_WIDTH);
	HAL_DMA_Start_IT(&HDMA_WVFM_A_HI, (uint32_t)wavetable_a_hi,
			(uint32_t)&DMA_DST_PWM_A_HI, WAVETABLE_WIDTH);
	HAL_DMA_Start_IT(&HDMA_WVFM_B_LO, (uint32_t)wavetable_b_lo,
			(uint32_t)&DMA_DST_PWM_B_LO, WAVETABLE_WIDTH);
	HAL_DMA_Start_IT(&HDMA_WVFM_B_HI, (uint32_t)wavetable_b_hi,
			(uint32_t)&DMA_DST_PWM_B_HI, WAVETABLE_WIDTH);

	/*
	  // Enable transfer complete interrupts
	  __HAL_DMA_ENABLE_IT(&hdma_tim8_ch1, DMA_IT_TC);
	  __HAL_DMA_ENABLE_IT(&hdma_tim8_ch2, DMA_IT_TC);
	  __HAL_DMA_ENABLE_IT(&hdma_tim8_ch3_up, DMA_IT_TC);
	  __HAL_DMA_ENABLE_IT(&hdma_tim8_ch4_trig_com, DMA_IT_TC);
	  // Enable transfer half complete interrupts
	  __HAL_DMA_ENABLE_IT(&hdma_tim8_ch1, DMA_IT_HT);
	  __HAL_DMA_ENABLE_IT(&hdma_tim8_ch2, DMA_IT_HT);
	  __HAL_DMA_ENABLE_IT(&hdma_tim8_ch3_up, DMA_IT_HT);
	  __HAL_DMA_ENABLE_IT(&hdma_tim8_ch4_trig_com, DMA_IT_HT);
	*/

	return;
}

void start_pwm_oc()
{
	// Start PWM for Volume outputs
	if ((HAL_TIM_PWM_Start(&HTIM_VOL_A, TIM_CH_VOL_A) |
		  HAL_TIM_PWM_Start(&HTIM_VOL_B, TIM_CH_VOL_B)) != HAL_OK)
	{
		Error_Handler();
	}
	// Start PWM output for PWM timers (the ones that actually output the LFOs)
	if ((HAL_TIM_PWM_Start(&HTIM_PWM_A_LO, TIM_CH_PWM_A_LO) |
			HAL_TIM_PWM_Start(&HTIM_PWM_A_HI, TIM_CH_PWM_A_HI) |
			HAL_TIM_PWM_Start(&HTIM_PWM_B_LO, TIM_CH_PWM_B_LO) |
			HAL_TIM_PWM_Start(&HTIM_PWM_B_HI, TIM_CH_PWM_B_HI)) != HAL_OK)
	{
		Error_Handler();
	}
	// Start output compare for waveform timers (to update the wavetables)
	if ((HAL_TIM_OC_Start(&HTIM_WVFM_A_LO, TIM_CH_WVFM_A_LO) |
		HAL_TIM_OC_Start(&HTIM_WVFM_A_HI, TIM_CH_WVFM_A_HI) |
		HAL_TIM_OC_Start(&HTIM_WVFM_B_LO, TIM_CH_WVFM_B_LO) |
		HAL_TIM_OC_Start(&HTIM_WVFM_B_HI, TIM_CH_WVFM_B_HI)) != HAL_OK)
	{
		Error_Handler();
	}
	return;
}

void start_uart()
{
	if(HAL_UART_Init(&HUART) != HAL_OK)
	{
		/* Initialization Error */
		Error_Handler();
	}
	/*##-2- Start the transmission process #####################################*/
	/* User start transmission data through "TxBuffer" buffer */


	/*
	///##-3- Put UART peripheral in reception process ###########################
	if(HAL_UART_Receive_DMA(&HUART, (uint8_t *)aRxBuffer, RXBUFFERSIZE) != HAL_OK)
	{
		//
		Error_Handler();
	}
	*/
}

void init_params()
{
	return;
}

// This maps named Adc struct members to the DMA buffer for convenience
void init_adc_channels(Adc *adc, uint32_t adc_buffer[]){
	adc->Rate = &adc_buffer[0];
	adc->Depth = &adc_buffer[1];
	adc->Phase = &adc_buffer[2];
	adc->Offset = &adc_buffer[3];
	adc->Sense = &adc_buffer[4];
	adc->Exp = &adc_buffer[5];
	adc->Env = &adc_buffer[6];
	adc->Trim2 = &adc_buffer[7];
	adc->Vol = &adc_buffer[8];
}

// Initialize LEDs with GPIO ports/pins, and set default states
void init_LEDs(LED* LED_bypass, LED* LED_tap){
	initLED(LED_tap, GREEN, OFF,
			pDOUT_LED1_R_GPIO_Port, pDOUT_LED1_R_Pin,
			pDOUT_LED1_G_GPIO_Port, pDOUT_LED1_G_Pin,
			pDOUT_LED1_B_GPIO_Port, pDOUT_LED1_B_Pin);
	initLED(LED_bypass, GREEN, OFF,
			pDOUT_LED2_R_GPIO_Port, pDOUT_LED2_R_Pin,
			pDOUT_LED2_G_GPIO_Port, pDOUT_LED2_G_Pin,
			pDOUT_LED2_B_GPIO_Port, pDOUT_LED2_B_Pin);
}





/*
 * CALLBACKS
 */

void HAL_TIM_IC_CaptureCallback(TIM_HandleTypeDef *htim)
{

}

void HAL_ADC_ConvCpltCallback(ADC_HandleTypeDef* hadc)
{

}

void My_DMA_XferHalfCpltCallback(DMA_HandleTypeDef *hdma)
{
	// TODO don't call function from interrupt
	set_LED_state(&LED_tap, OFF);
	return;
}

void My_DMA_XferCpltCallback(DMA_HandleTypeDef *hdma)
{
	set_LED_state(&LED_tap, ON);
	return;
}


/* USER CODE END 4 */

/**
  * @brief  This function is executed in case of error occurrence.
  * @retval None
  */
void Error_Handler(void)
{
  /* USER CODE BEGIN Error_Handler_Debug */
  /* User can add his own implementation to report the HAL error return state */
  __disable_irq();

  HAL_GPIO_WritePin(pDOUT_LED2_B_GPIO_Port, pDOUT_LED2_B_Pin, LED_PIN_SET);
  HAL_GPIO_WritePin(pDOUT_LED2_R_GPIO_Port, pDOUT_LED2_R_Pin, LED_PIN_SET);
  HAL_GPIO_WritePin(pDOUT_LED2_G_GPIO_Port, pDOUT_LED2_G_Pin, LED_PIN_SET);
  HAL_GPIO_WritePin(pDOUT_LED1_B_GPIO_Port, pDOUT_LED1_B_Pin, LED_PIN_SET);
  HAL_GPIO_WritePin(pDOUT_LED1_R_GPIO_Port, pDOUT_LED1_R_Pin, LED_PIN_SET);
  HAL_GPIO_WritePin(pDOUT_LED1_G_GPIO_Port, pDOUT_LED1_G_Pin, LED_PIN_SET);

  while (1)
  {
	  HAL_Delay(250);

	  HAL_GPIO_TogglePin(pDOUT_LED2_B_GPIO_Port, pDOUT_LED2_B_Pin);
	  HAL_GPIO_TogglePin(pDOUT_LED2_R_GPIO_Port, pDOUT_LED2_R_Pin);
	  HAL_GPIO_TogglePin(pDOUT_LED2_G_GPIO_Port, pDOUT_LED2_G_Pin);
	  HAL_GPIO_TogglePin(pDOUT_LED1_B_GPIO_Port, pDOUT_LED1_B_Pin);
	  HAL_GPIO_TogglePin(pDOUT_LED1_R_GPIO_Port, pDOUT_LED1_R_Pin);
	  HAL_GPIO_TogglePin(pDOUT_LED1_G_GPIO_Port, pDOUT_LED1_G_Pin);

  }
  /* USER CODE END Error_Handler_Debug */
}

#ifdef  USE_FULL_ASSERT
/**
  * @brief  Reports the name of the source file and the source line number
  *         where the assert_param error has occurred.
  * @param  file: pointer to the source file name
  * @param  line: assert_param error line source number
  * @retval None
  */
void assert_failed(uint8_t *file, uint32_t line)
{
  /* USER CODE BEGIN 6 */
  /* User can add his own implementation to report the file name and line number,
     ex: printf("Wrong parameters value: file %s on line %d\r\n", file, line) */
  /* USER CODE END 6 */
}
#endif /* USE_FULL_ASSERT */
